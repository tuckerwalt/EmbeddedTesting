# file: STCubeGenerated.ioc
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Mcu.Family=STM32C0
Mcu.Name=STM32C031C(4-6)Tx
Mcu.Package=LQFP48
ProjectManager.HeapSize=0x200
ProjectManager.StackSize=0x400
ProjectManager.TargetToolchain=MDK-ARM V5
RCC.ADCFreq_Value=12000000
RCC.AHBFreq_Value=12000000
RCC.CortexFreq_Value=12000000
RCC.EXTERNAL_CLOCK_VALUE=12288000
RCC.HCLKFreq_Value=12000000
RCC.HSE_VALUE=8000000
RCC.HSI_VALUE=48000000
RCC.LSE_VALUE=32768
RCC.SYSCLKFreq_VALUE=12000000
board=custom

// file: Src/main.c
/* USER CODE BEGIN Header */
/**
  ******************************************************************************
  * @file           : main.c
  * @brief          : Main program body
  ******************************************************************************
  * @attention
  *
  * Copyright (c) 2024 STMicroelectronics.
  * All rights reserved.
  *
  * This software is licensed under terms that can be found in the LICENSE file
  * in the root directory of this software component.
  * If no LICENSE file comes with this software, it is provided AS-IS.
  *
  ******************************************************************************
  */
/* USER CODE END Header */
#include "main.h"

/* USER CODE BEGIN Includes */
#include <stdio.h>
/* USER CODE END Includes */

void SystemClock_Config(void);

/* USER CODE BEGIN 0 */

// USER LED -> output GPIOA pin 5
// USER BTN -> input GPIOC pin 13

#define RCC_IOPENR (*(volatile unsigned int *)(0x40021000U + 0x34U))
#define GPIOA_OFF (0x01U << 0)
#define PIN5 (0x01U << 5)
#define BIGPIN5 (0x3U << 10)

void delay(volatile unsigned int iter)
{
  while (iter > 0)
    --iter;
}

// not atomic
// read the output, and flip the selected pin(s)
void toggle_GPIO(GPIO_TypeDef *loc, uint32_t pin)
{
  volatile uint32_t odr = loc->ODR;
  loc->BSRR = ((odr & pin) << 16) | (~odr & pin);
}

int main(void)
{
  uint32_t tmp;

  //RCC_IOPENR |= GPIOA_OFF; // enable clock for GPIOA
  RCC->IOPENR |= RCC_IOPENR_GPIOAEN;

  // Define pin5 of GPIOA as an output
  tmp = GPIOA->MODER;
  tmp &= ~GPIO_MODER_MODE5; // Clear pin5 port mode
  tmp |= GPIO_MODER_MODE5_0; // set first bit of pin5 port mode GPIOA (01 = output)
  GPIOA->MODER = tmp;

  GPIOA->OTYPER &= ~GPIO_OTYPER_OT5; // set pin 5 output type as push-pull (0)

  tmp = GPIOA->OSPEEDR;
  tmp &= ~GPIO_OSPEEDR_OSPEED5; // clear pin5 speed
  tmp |= GPIO_OSPEEDR_OSPEED5_0; // set first bit of pin5 speed GPIOA (01 = low speed)
  GPIOA->OSPEEDR = tmp;

  GPIOA->PUPDR &= ~GPIO_PUPDR_PUPD5; // Clear pin5 pullup/pulldown (0 = neither)

  // make sure the pin is reset
  GPIOA->BSRR = GPIO_BSRR_BR5; // reset pin 5 (LED)
  while (1)
  {
    //GPIOA BSRR = GPIOA(0x50000000) + BSRR(0x18)
    //GPIOA->BSRR = GPIO_BSRR_BS5; // set pin 5 (LED)
    //HAL_GPIO_TogglePin(GPIOA, GPIO_PIN_5);
    toggle_GPIO(GPIOA, GPIO_PIN_5);
    delay(500000);

    //GPIOA->BSRR = GPIO_BSRR_BR5; // reset pin 5 (LED)
    toggle_GPIO(GPIOA, GPIO_PIN_5);
    delay(1000000);

  }

  return 0;
}

/* USER CODE END 0 */

int dummy(void)
{

  /* MCU Configuration--------------------------------------------------------*/

  /* Reset of all peripherals, Initializes the Flash interface and the Systick. */
  //HAL_Init();

  /* Configure the system clock */
  //SystemClock_Config();

  /* Initialize all configured peripherals */

  /* Infinite loop */
  /* USER CODE BEGIN WHILE */
  int counter = 0;

  while (1)
  {
    counter += 3;
    counter *= 3;
    //printf("hi\n");
    /* USER CODE END WHILE */

    /* USER CODE BEGIN 3 */
  }
  return 0;
  /* USER CODE END 3 */
}

void SystemClock_Config(void)
{
  RCC_OscInitTypeDef RCC_OscInitStruct = {0};
  RCC_ClkInitTypeDef RCC_ClkInitStruct = {0};

  /** Initializes the RCC Oscillators according to the specified parameters
  * in the RCC_OscInitTypeDef structure.
  */
  RCC_OscInitStruct.OscillatorType = RCC_OSCILLATORTYPE_HSI;
  RCC_OscInitStruct.HSIState = RCC_HSI_ON;
  RCC_OscInitStruct.HSIDiv = RCC_HSI_DIV4;
  RCC_OscInitStruct.HSICalibrationValue = RCC_HSICALIBRATION_DEFAULT;
  if (HAL_RCC_OscConfig(&RCC_OscInitStruct) != HAL_OK)
  {
    Error_Handler();
  }

  /** Initializes the CPU, AHB and APB buses clocks
  */
  RCC_ClkInitStruct.ClockType = RCC_CLOCKTYPE_HCLK|RCC_CLOCKTYPE_SYSCLK
                              |RCC_CLOCKTYPE_PCLK1;
  RCC_ClkInitStruct.SYSCLKSource = RCC_SYSCLKSOURCE_HSI;
  RCC_ClkInitStruct.SYSCLKDivider = RCC_SYSCLK_DIV1;
  RCC_ClkInitStruct.AHBCLKDivider = RCC_HCLK_DIV1;
  RCC_ClkInitStruct.APB1CLKDivider = RCC_APB1_DIV1;

  if (HAL_RCC_ClockConfig(&RCC_ClkInitStruct, FLASH_LATENCY_0) != HAL_OK)
  {
    Error_Handler();
  }
}

void Error_Handler(void)
{
  __disable_irq();
  while (1)
  {
  }
}
